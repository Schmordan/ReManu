## config/boards/shields/remanu/Kconfig.defconfig
```kconfig
if SHIELD_REMANU_LEFT

config ZMK_KEYBOARD_NAME
    default "ReManu"

config ZMK_SPLIT_ROLE_CENTRAL
    default y

endif

if SHIELD_REMANU_LEFT || SHIELD_REMANU_RIGHT

config ZMK_SPLIT
    default y

endif
```

## config/boards/shields/remanu/Kconfig.shield
```kconfig
config SHIELD_REMANU_LEFT
    def_bool $(shields_list_contains,remanu_left)

config SHIELD_REMANU_RIGHT
    def_bool $(shields_list_contains,remanu_right)
```
